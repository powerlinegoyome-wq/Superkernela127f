## drivers/mmc/Kconfig
```kconfig
#
# MMC subsystem configuration
#

menuconfig MMC
	tristate "MMC/SD/SDIO card support"
	depends on HAS_IOMEM
	help
	  Find out whether you have a SPI, I2C, MMC, SD or SDIO based Card
	  plugged into your system and whether the card is useful for anything.

config MMC_CRC
	bool "Enable MMC/SD/SDIO hardware CRC"
	depends on MMC
	default n
	help
	  This option enables the hardware CRC for MMC/SD/SDIO devices.
	  Disabling this option can improve I/O speeds up to 30% by ignoring
	  CRC checking on data transfers. MMC/SD/SDIO support, you should say Y here and
	  also to your specific host controller driver.

config MMC_SUPPORT_STLOG
 	bool "Enable storage log"
 	depends on MMC && PROC_STLOG
 	default y

config MMC_TEST_MODE
	bool "Samsung MMC TEST feature"
	depends on MMC != n

	---help---
	This selects support for test mode for debugging.
	Select this option if this feature is needed on working.

if MMC

source "drivers/mmc/core/Kconfig"

source "drivers/mmc/host/Kconfig"

endif # MMC
```
